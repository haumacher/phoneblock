## phoneblock-dongle/firmware/main/Kconfig.projbuild
```kconfig
menu "PhoneBlock Dongle"

    config PHONEBLOCK_BASE_URL
        string "PhoneBlock base URL"
        default "https://phoneblock.net/phoneblock"
        help
            Root URL of the PhoneBlock web deployment. The firmware
            appends /api/num/{phone}, /api/rate, /api/test etc. for
            REST calls, and /mobile/login for the OAuth token flow.

            Two deployments exist:
              * https://phoneblock.net/phoneblock — production
              * https://phoneblock.net/pb-test    — test instance

            A token is bound to exactly one instance. Tokens generated on
            the test instance only work there, and vice versa. The token
            prefix (pbt_) is the same in both cases.

    config PHONEBLOCK_OTA_MANIFEST_URL
        string "OTA update manifest URL"
        default "https://cdn.phoneblock.net/dongle/firmware/stable/manifest.json"
        help
            HTTPS URL the dongle polls for OTA updates. This is the
            same esp-web-tools manifest that the browser-based
            installer uses, so there is exactly one source of truth
            per release. Expected shape (as written by release.sh):

              {"name": "PhoneBlock Dongle",
               "version": "1.0.3",
               "builds": [{
                 "chipFamily": "ESP32",
                 "parts": [
                   {"path": ".../bootloader.bin",        "offset": 4096},
                   {"path": ".../partition-table.bin",   "offset": 32768},
                   {"path": ".../ota_data_initial.bin",  "offset": 61440},
                   {"path": ".../phoneblock_dongle.bin", "offset": 131072}]}]}

            Browser-side esp-web-tools flashes all four parts; OTA
            here picks the part whose path ends in
            "phoneblock_dongle.bin" (the app slot) and ignores the
            rest, since bootloader / partition-table / ota_data are
            only needed on the very first USB flash.

            When `version` differs from the running image,
            esp_https_ota fetches the picked binary and flips the
            boot partition. TLS trust is provided by the bundled
            Mozilla root CA store (enabled via
            CONFIG_MBEDTLS_CERTIFICATE_BUNDLE_DEFAULT_FULL).

    config SIP_REGISTRAR_PORT
        int "SIP registrar port"
        default 5060
        range 1 65535
        help
            Default port written into NVS when the user does not
            override it through the web UI. Registrar host, username
            and password are not configurable via Kconfig — they go
            through the setup wizard.

    config SIP_EXPIRES
        int "Requested registration lifetime (seconds)"
        default 3600
        range 60 86400
        help
            Maximum lifetime requested in the REGISTER's "Expires:"
            header. The registrar caps this to its own limit
            (Fritz!Box: 600 s) and returns the granted value in the
            200 OK; the dongle then refreshes at granted/2 — so this
            setting is a *desired upper bound*, not the actual refresh
            interval. Bumping it above the registrar's cap has no
            effect; setting it below caps us further than the
            registrar would.

    config SIP_CONTACT_HOST_OVERRIDE
        string "Override local host in Via/Contact (for NAT debugging)"
        default ""
        help
            When running inside QEMU user-mode networking, the ESP32's
            local IP (e.g. 10.0.2.15) is only reachable from within the
            emulator. The Fritz!Box cannot deliver an INVITE to that
            address. Set this to the host-visible address (typically the
            workstation's LAN IP, e.g. 192.168.178.22) and combine with
            `-nic user,model=open_eth,hostfwd=udp::5061-:5061` in QEMU.
            Leave empty to advertise the actual local interface IP,
            which is the correct behavior on real hardware.

    config SIP_CONTACT_PORT_OVERRIDE
        int "Override local SIP port in Via/Contact (0 = no override)"
        default 0
        range 0 65535
        help
            If the hostfwd maps a different host port to the guest, set
            it here. 0 means "advertise the bound UDP port".

    config SIP_TEST_FORCE_SPAM_STAR_NUMBERS
        bool "Default for the runtime 'Accept local test calls' toggle"
        default n
        help
            Initial state of the runtime "Lokale Testanrufe annehmen"
            checkbox in the web UI under Spam-Ansage. The first time
            the dongle boots (NVS key empty), this Kconfig value
            decides whether the test hook is on or off; once the user
            toggles the checkbox, the persisted runtime value wins
            and survives reboots / firmware updates until factory
            reset.

            When the toggle is on, callers whose number starts with
            '*' (Fritz!Box internal dial codes like **622 or *21#)
            are treated as SPAM and answered with 200 OK + tone +
            BYE, bypassing both the display-name phone-book skip
            and the PhoneBlock API. Lets you exercise the full
            answer + audio + hangup path by calling your IP-phone
            extension from another internal Fritz!Box phone,
            without blacklisting a real number.

    config STATUS_LED_GPIO
        int "Status LED GPIO (-2 = auto-detect, -1 = disable)"
        default -2
        range -2 48
        help
            GPIO driven by the status LED task with blink patterns
            for PAIRING / CONNECTING / SETUP / READY.

              -2 (default) = auto-detect: GPIO 10 on chips with
                             embedded flash (EGBO PICO-D4 dongle —
                             flash inside the SoC, GPIO 10 free as
                             a regular pin), GPIO 2 otherwise (the
                             on-board blue LED of ESP32-WROOM-32
                             dev boards, where GPIO 10 carries the
                             external flash WP signal and is unsafe
                             to drive). Polarity is auto-detected
                             too: the GPIO 10 dongle LED is wired
                             active-low, the WROOM-32 on-board LED
                             active-high; STATUS_LED_ACTIVE_LOW is
                             ignored in this mode.
              -1           = disable the LED task entirely.
              0..48        = explicit pin override for non-standard
                             hardware. Polarity then comes from
                             STATUS_LED_ACTIVE_LOW.

    config STATUS_LED_ACTIVE_LOW
        bool "Status LED is active-low"
        default n
        help
            Enable if the LED is wired so that a LOW GPIO level
            turns it on (e.g. LED-to-3V3-via-resistor topology).
            The WROOM-32 on-board LED is active-high; leave
            disabled for that case.

            Only consulted when STATUS_LED_GPIO is an explicit pin
            (0..48). In auto-detect mode (STATUS_LED_GPIO=-2) the
            polarity is derived together with the pin from the
            chip type and this setting is ignored.

    config RTP_PLAY_ANNOUNCEMENT
        bool "Play embedded voice announcement to spam callers"
        default y
        help
            When enabled, answered spam calls stream the audio file
            embedded from main/audio/announcement.alaw to the caller
            (G.711 A-law, 8 kHz, 20 ms frames) before BYE. Disable to
            send BYE immediately after ACK (silent pickup, old behavior).

endmenu
```
