## phoneblock-dongle/firmware/sdkconfig.defaults
```kconfig
# Defaults target real ESP32 hardware: WiFi, SIP expiry tuned for
# Fritz!Box bindings, and a status LED that auto-detects the right
# GPIO between PICO-D4 (production dongle) and WROOM-32 (dev board)
# at runtime. The QEMU emulator overrides the network/LED/NAT bits
# in sdkconfig.defaults.local — see sdkconfig.defaults.local.template
# for the worked overrides.

# Network: WiFi for real hardware (production + WROOM-32 dev). The
# QEMU emulator overrides this in .local to OpenCores Ethernet.
CONFIG_EXAMPLE_CONNECT_WIFI=y
CONFIG_EXAMPLE_CONNECT_ETHERNET=n
CONFIG_EXAMPLE_USE_OPENETH=n
CONFIG_EXAMPLE_CONNECT_IPV4=y
CONFIG_EXAMPLE_CONNECT_IPV6=y

# WiFi credentials. Must be supplied in sdkconfig.defaults.local for
# every real-hardware build (gitignored, so credentials don't leak).
# QEMU builds switch to Ethernet and ignore these.
CONFIG_EXAMPLE_WIFI_SSID=""
CONFIG_EXAMPLE_WIFI_PASSWORD=""

# TLS: use the bundled Mozilla root CA store so HTTPS to phoneblock.net
# validates out of the box.
CONFIG_MBEDTLS_CERTIFICATE_BUNDLE=y
CONFIG_MBEDTLS_CERTIFICATE_BUNDLE_DEFAULT_FULL=y

# TLS session resumption for the spam-lookup path. The dongle does
# only 1-2 /api/check-prefix calls per day; a full TLS handshake costs
# ~1-2 s on the ESP32 - long enough for the Fritz!Box to start ringing
# the real phones before the verdict is in. That cost is almost all
# asymmetric crypto on the 240 MHz CPU (a full handshake measures
# ~140 ms from a fast x86 but ~1.7 s on the dongle - the gap is
# certificate-chain verify + signature + ECDHE, not the network).
# With this enabled, api.c keeps a persistent esp_http_client handle
# whose RFC 5077 session ticket survives between calls (see
# save_client_session), so the second and later lookups skip exactly
# that crypto. No connection is held open - only the ticket blob is
# cached in RAM, and the server keeps no per-client state. Default is
# n; MBEDTLS_CLIENT_SSL_SESSION_TICKETS (the underlying mbedTLS
# support) is already default y.
CONFIG_ESP_TLS_CLIENT_SESSION_TICKETS=y

# TLS 1.3 is deliberately left disabled (also the IDF default).
# esp_http_client saves the session for resumption right after the
# handshake completes - but a TLS 1.3 server sends its session ticket
# as a post-handshake message that has not arrived at that point, so
# the saved session carries no usable ticket and every lookup falls
# back to a full handshake. TLS 1.2 delivers the ticket in-handshake,
# so resumption works there. TLS 1.3 would only save ~1 round-trip
# (~30 ms measured) on a *full* handshake - negligible next to the
# ~1.5 s of crypto that resumption removes. The lookup client also
# pins TLS 1.2 explicitly - see check_client() in api.c.
CONFIG_MBEDTLS_SSL_PROTO_TLS1_3=n

# Main task stack: 8 KB is enough for cJSON + TLS + example helpers.
CONFIG_ESP_MAIN_TASK_STACK_SIZE=8192

# esp_event task stack: 2.75 KB, up from the 2304 B default. wifi.c runs
# its event handlers here and logs WARN lines from them (failsafe / WPS),
# which since the log-capture hook (log_capture.c) cost an extra ~110 B of
# frame. The default left too little headroom for that on a deep handler
# (schedule_failsafe even spawns a task inline). 2.75 KB clears it with
# margin. The only IDF-owned task into which our own code logs warnings.
CONFIG_ESP_SYSTEM_EVENT_TASK_STACK_SIZE=2816

# HTTP server: browsers return from the phoneblock.net OAuth flow with
# sizeable referrer + cookie + security headers (Chrome easily hits 1.5 kB
# on a single request). The default 512-byte buffer rejects those with
# HTTP 431. 4 kB covers anything a real browser will ever send.
CONFIG_HTTPD_MAX_REQ_HDR_LEN=4096
CONFIG_HTTPD_MAX_URI_LEN=1024

# lwip socket pool. Default 10 is too tight: SIP-UDP + HTTPD-listen +
# 4–6 parallel browser-polling connections + mDNS/DHCP already crowd
# the pool, and a TR-064 HTTP-client started during a browser poll
# then fails with "Failed to create socket" / ESP_ERR_HTTP_CONNECT.
CONFIG_LWIP_MAX_SOCKETS=16

# 4 MB of SPI flash: the ESP32 modules we ship with have 4 MB onboard
# (the EGBO PICO-D4 packages flash in the SoC; WROOM-32 dev boards
# use an external 4 MB chip). The IDF default is 2 MB, which cuts
# our partition table (two 1664 KB OTA slots + 640 KB SPIFFS) in half.
CONFIG_ESPTOOLPY_FLASHSIZE_4MB=y
CONFIG_ESPTOOLPY_FLASHSIZE="4MB"

# Custom partition table: OTA-capable layout (ota_0/ota_1/otadata)
# plus a SPIFFS slot for the user-uploaded voice announcement.
# See partitions.csv for the offsets and sizes.
CONFIG_PARTITION_TABLE_CUSTOM=y
CONFIG_PARTITION_TABLE_CUSTOM_FILENAME="partitions.csv"

# Core dump: write a full ELF core dump to the dedicated "coredump"
# partition (see partitions.csv, 52 KB) when the panic handler fires.
# On the next boot, crashreport.c reads the dump, POSTs it to the
# PhoneBlock backend, and erases the slot. ELF format keeps the dump
# loadable with espcoredump.py and a matching firmware.elf — the
# release script ships the ELF alongside the .bin on the CDN. The
# CHECK_BOOT flag has the bootloader sanity-check the stored dump on
# every boot; corrupted dumps are wiped instead of poisoning the slot.
CONFIG_ESP_COREDUMP_ENABLE_TO_FLASH=y
CONFIG_ESP_COREDUMP_DATA_FORMAT_ELF=y
CONFIG_ESP_COREDUMP_CHECK_BOOT=y

# Task watchdog. Catches infinite hangs in tasks that talk to the
# network synchronously (sip_task → phoneblock_check → mbedtls TLS
# read can wedge below esp_http_client's timeout when the peer half-
# closes the connection). Without this the device just freezes and
# we get no coredump. PANIC=y turns a missed reset into the regular
# panic path, which then writes a coredump to flash (see above) and
# reboots — exactly what we want for diagnostics.
#
# Timeout 120 s: the watchdog is a last-resort catch for a genuinely
# wedged task, not a tight per-iteration budget. The worst legitimate
# single-iteration cost in sip_task (one phoneblock_check + one
# do_register, ~10 s each) and the TR-064 provisioning chain that
# fans one SOAP call per Fritz!Box telephony client (each bounded by
# the 5 s HTTP timeout) both sum well under this. A generous ceiling
# keeps a slow-but-progressing operation from tripping a false panic;
# the individual operations carry their own tighter timeouts.
#
# IDLE_TASK_CPU0/CPU1 keep the default IDF behaviour of watching
# the idle tasks too, so a runaway high-priority task that starves
# the scheduler still trips the watchdog.
CONFIG_ESP_TASK_WDT_EN=y
CONFIG_ESP_TASK_WDT_INIT=y
CONFIG_ESP_TASK_WDT_PANIC=y
# 60 s is the Kconfig maximum (range 1..60). 120 was silently rejected as
# out-of-range and fell back to the default of 5 s, which rebooted the
# dongle whenever an httpd handler briefly blocked (token-test TLS
# round-trip, large page send). 60 s covers any legitimate operation (the
# API HTTP timeout is 10 s) while still catching a real hang within a
# minute. A longer window would require reconfiguring the TWDT at runtime.
CONFIG_ESP_TASK_WDT_TIMEOUT_S=60
CONFIG_ESP_TASK_WDT_CHECK_IDLE_TASK_CPU0=y
CONFIG_ESP_TASK_WDT_CHECK_IDLE_TASK_CPU1=y

# Per-task run-time statistics, surfaced on /api/status ("system.tasks")
# and the web Protokoll/System card. This is the field-diagnosis path for
# "the dongle is hot / unstable" — it makes a runaway task visible as a
# high CPU% instead of having to guess. USE_TRACE_FACILITY adds the task
# list + stack-high-water; GENERATE_RUN_TIME_STATS adds the per-task CPU
# counter (clocked off esp_timer, the IDF default source, so the cost is
# a cheap timer read per context switch).
CONFIG_FREERTOS_USE_TRACE_FACILITY=y
CONFIG_FREERTOS_GENERATE_RUN_TIME_STATS=y

# OTA rollback: the bootloader marks a freshly flashed image as
# "pending verify". The app must call
# esp_ota_mark_app_valid_cancel_rollback() after a successful
# self-test (WiFi up + PhoneBlock API reachable), otherwise the
# bootloader reverts to the previous slot on the next reboot.
CONFIG_BOOTLOADER_APP_ROLLBACK_ENABLE=y

# SPIFFS tuning for the announcement slot: the default 256-byte
# logical-page size is optimised for many tiny files; we have one
# 60–240 KB blob, and 1024-byte pages ~quadruple raw write
# throughput. Requires a reformat — we mount with
# format_if_mount_failed=true, so the change takes effect on the
# next boot after flashing.
CONFIG_SPIFFS_PAGE_SIZE=1024

# PhoneBlock backend. Production by default; the test instance
# "https://phoneblock.net/pb-test" goes in .local for dev builds.
# Tokens are bound to one instance — a token generated on the test
# site only works there, and vice versa. Token itself is set via the
# OAuth setup wizard and persisted in NVS — no Kconfig knob for it.
# Site root URL, *without* "/api" suffix; api.c and web.c append
# /api/... and /mobile/... themselves.
CONFIG_PHONEBLOCK_BASE_URL="https://phoneblock.net/phoneblock"

# OTA base URL: the firmware appends "/<channel>/manifest.json" (the
# channel is a runtime web-UI toggle, "stable" by default). The polled
# file is the same esp-web-tools manifest the browser-based installer
# reads, so there is one source of truth per release. Override in
# .local to point at a staging CDN bucket.
CONFIG_PHONEBLOCK_OTA_BASE_URL="https://cdn.phoneblock.net/dongle/firmware"

# SIP. Registrar/username/password are written to NVS by the web
# setup wizard. SIP_EXPIRES is the *requested* upper bound for the
# REGISTER binding lifetime; the registrar caps it (Fritz!Box: 600 s)
# and the dongle refreshes at granted/2 read from the 200 OK, so the
# precise value here only matters when the registrar's cap is
# higher than what we're willing to ask for.
CONFIG_SIP_REGISTRAR_PORT=5060
CONFIG_SIP_EXPIRES=3600

# SIP NAT overrides. Empty / 0 on real hardware — the dongle then
# advertises its actual interface IP and bound UDP port in Via /
# Contact. QEMU user-mode networking puts the guest behind 10.0.2.x,
# unreachable from the Fritz!Box; emulator builds set both in .local
# (host LAN IP + the host port mapped via -hostfwd udp::15060-:15060).
CONFIG_SIP_CONTACT_HOST_OVERRIDE=""
CONFIG_SIP_CONTACT_PORT_OVERRIDE=0

# Default state of the runtime "Accept local test calls" toggle in
# the web UI (Spam-Ansage section). Used only when the dongle's NVS
# key is empty — i.e. on first boot or after factory reset. Once the
# user touches the toggle, the persisted runtime value wins.
# Off in production; dev .local files enable it so a fresh test
# build comes up answering Fritz!Box *-codes as spam without having
# to click through the UI first.
CONFIG_SIP_TEST_FORCE_SPAM_STAR_NUMBERS=n

# Status LED. -2 means "auto-detect": the task picks GPIO 10 on
# chips with embedded flash (EGBO PICO-D4 dongle) and GPIO 2 on
# WROOM-32 dev boards (whose GPIO 10 carries the external SPI flash
# WP signal and is not safe to drive). Same firmware boots correctly
# on both variants without an .local override; pin this to a
# concrete value (0..48) only for non-standard hardware, or set -1
# to disable the LED task entirely.
CONFIG_STATUS_LED_GPIO=-2
CONFIG_STATUS_LED_ACTIVE_LOW=n

# Embedded voice announcement on answered spam calls. Off would skip
# audio playback and BYE the call right after ACK. Default y; only
# disable for silent-pickup experiments.
CONFIG_RTP_PLAY_ANNOUNCEMENT=y

# Dev-only crash trigger. When y, the web UI shows a "Panic auslösen
# (Dev)" button and the firmware compiles in POST /api/dev/crash to
# exercise the coredump-and-upload pipeline end-to-end. MUST stay n
# for production; flipped to y in sdkconfig.defaults.local for
# bench builds.
CONFIG_CRASH_TEST_ENABLE=n
```

## phoneblock-dongle/firmware/sdkconfig.defaults.local.fritzbox
```kconfig
# Local override template — home Fritz!Box WLAN.
#
# Copy into place before building:
#
#   cp sdkconfig.defaults.local.fritzbox sdkconfig.defaults.local
#   rm sdkconfig && idf.py build
#
# sdkconfig.defaults.local is gitignored; the values below are the
# only ones that should differ between environments.

# Dev instance. Switch to
#   CONFIG_PHONEBLOCK_BASE_URL="https://phoneblock.net/phoneblock"
# for a production build.
CONFIG_PHONEBLOCK_BASE_URL="https://phoneblock.net/pb-test"

# Real hardware → WiFi instead of the Ethernet/OpenCores default from
# sdkconfig.defaults.
CONFIG_EXAMPLE_CONNECT_ETHERNET=n
CONFIG_EXAMPLE_USE_OPENETH=n
CONFIG_EXAMPLE_CONNECT_WIFI=y
CONFIG_EXAMPLE_WIFI_SSID="REPLACE_WITH_FRITZBOX_SSID"
CONFIG_EXAMPLE_WIFI_PASSWORD="REPLACE_WITH_FRITZBOX_PASSWORD"

# Re-register every 5 min. The Fritz!Box expires IP-phone bindings at
# 600 s by default; halving the interval gives us one retry budget
# before the box drops us.
CONFIG_SIP_EXPIRES=300

# Dev-only: internal Fritz!Box callers (**622, *21#, …) are answered
# as spam so the 200 OK + tone + BYE path is exercised without
# blacklisting a real number on PhoneBlock. Remove once real call
# handling is being validated.
CONFIG_SIP_TEST_FORCE_SPAM_STAR_NUMBERS=y
```

## phoneblock-dongle/firmware/sdkconfig.defaults.local.handy
```kconfig
# Local override template — mobile-phone hotspot (2,4 GHz, WPA2).
#
# Copy into place before building:
#
#   cp sdkconfig.defaults.local.handy sdkconfig.defaults.local
#   rm sdkconfig && idf.py build
#
# sdkconfig.defaults.local is gitignored; the values below are the
# only ones that should differ between environments.

# Dev instance. Tokens created on pb-test only work there.
CONFIG_PHONEBLOCK_BASE_URL="https://phoneblock.net/pb-test"

# Real hardware → WiFi instead of the Ethernet/OpenCores default from
# sdkconfig.defaults.
CONFIG_EXAMPLE_CONNECT_ETHERNET=n
CONFIG_EXAMPLE_USE_OPENETH=n
CONFIG_EXAMPLE_CONNECT_WIFI=y
CONFIG_EXAMPLE_WIFI_SSID="REPLACE_WITH_HOTSPOT_SSID"
CONFIG_EXAMPLE_WIFI_PASSWORD="REPLACE_WITH_HOTSPOT_PASSWORD"

# Shorter re-register interval is friendlier when debugging over a
# mobile hotspot that may drop clients when the phone locks.
CONFIG_SIP_EXPIRES=300

# Dev-only: internal Fritz!Box callers (**622, *21#, …) are answered
# as spam so the 200 OK + tone + BYE path is exercised without
# blacklisting a real number on PhoneBlock.
CONFIG_SIP_TEST_FORCE_SPAM_STAR_NUMBERS=y
```
